## boards/arm/kit_desenvolvimento/Kconfig.board
```kconfig
# Copyright (c) 2023 Nordic Semiconductor ASA
# SPDX-License-Identifier: Apache-2.0

config BOARD_KIT_DESENVOLVIMENTO
	bool "Kit_Desenvolvimento"
	depends on SOC_NRF5340_CPUNET_QKAA
```

## boards/arm/kit_desenvolvimento/Kconfig.defconfig
```kconfig
# Copyright (c) 2023 Nordic Semiconductor ASA
# SPDX-License-Identifier: Apache-2.0

if BOARD_KIT_DESENVOLVIMENTO

config BOARD
	default "kit_desenvolvimento"

config BT_CTLR
   default BT

endif
```
